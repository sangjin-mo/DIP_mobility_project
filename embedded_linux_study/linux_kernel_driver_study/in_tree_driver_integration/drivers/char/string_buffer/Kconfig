## embedded_linux_study/linux_kernel_driver_study/in_tree_driver_integration/drivers/char/string_buffer/Kconfig
```kconfig
config STRING_BUFFER_DRIVER
	tristate "Educational string-buffer character driver"
	default n
	help
	  Build a simple character driver that stores up to 255 bytes written
	  from user space and returns the most recently stored bytes on read.

	  Select Y to link the driver into the kernel image. Select M to build
	  it as a loadable module named string_buffer. This driver is intended
	  for Linux driver integration and concurrency-control exercises.
```
